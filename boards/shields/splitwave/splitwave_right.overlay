#include "splitwave.dtsi"

&default_transform { // Offset of 3 because the left side has 3 columns
    col-offset = <5>;
};

&kscan0 {
        col-gpios 
        = <&gpio0 31 (GPIO_ACTIVE_HIGH)>,
        <&gpio0 29 (GPIO_ACTIVE_HIGH)>,
        <&gpio0 2 (GPIO_ACTIVE_HIGH)>,
        <&gpio1 15 (GPIO_ACTIVE_HIGH)>,
        <&gpio1 13 (GPIO_ACTIVE_HIGH)>;
};
